## conf/distro/include/intel-camera.inc
```bitbake
SECURITY_CFLAGS_pn-cameralinuxadapt = "${SECURITY_NO_PIE_CFLAGS}"
SECURITY_CFLAGS_pn-camerasource = "${SECURITY_NO_PIE_CFLAGS}"
SECURITY_CFLAGS_pn-icameraadapter = "${SECURITY_NO_PIE_CFLAGS}"

REFKIT_IMAGE_EXTRA_INSTALL_intel-corei7-64 += "fw-ipu4 camera3hal icameraadapter cameraunittests aiqb ipu4mod camerasource pvl-gst pvl-cvtrace pvl-libs"

SUPPORTED_RECIPES_append = " ${META_INTEL_CAMERA_BASE}/conf/distro/include/intel-camera-supported-recipes.txt"
```

## conf/layer.conf
```bitbake
# We have a conf and classes directory, add to BBPATH
BBPATH .= ":${LAYERDIR}"

# We have recipes-* directories, add to BBFILES
BBFILES += "${LAYERDIR}/recipes-*/*/*.bb \
         ${LAYERDIR}/recipes-*/*/*.bbappend"

BBFILE_COLLECTIONS += "intelcamera"
BBFILE_PATTERN_intelcamera = "^${LAYERDIR}/"
BBFILE_PRIORITY_intelcamera = "15"

LAYERVERSION_intelcamera = "1"
LAYERDEPENDS_intelcamera = "core"

# Set a variable to get to the top of the Intel Camera metadata location.
META_INTEL_CAMERA_BASE := '${LAYERDIR}'

include conf/distro/include/intel-camera.inc

MACHINE_ESSENTIAL_EXTRA_RDEPENDS_append_intel-corei7-64 = " \
    camera-drivers \
"
```
